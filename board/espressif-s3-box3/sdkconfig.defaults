## board/espressif-s3-box3/sdkconfig.defaults
```kconfig
CONFIG_BSP_BOARD_TYPE_NAME="Espressif S3 Box3"
CONFIG_BSP_FLASH_SIZE=16384
CONFIG_BSP_I2C0_SCL=18
CONFIG_BSP_I2C0_SDA=8
CONFIG_BSP_I2C1_SCL=40
CONFIG_BSP_I2C1_SDA=41
CONFIG_BSP_I2C2_SCL=-1
CONFIG_BSP_I2C2_SDA=-1
CONFIG_BSP_LEDPIXEL0=-1
CONFIG_BSP_LEDPIXEL1=39
CONFIG_BSP_LEDPIXEL2=-1
CONFIG_BSP_LEDPIXEL3=-1
CONFIG_BSP_LEDPWM0=-1
CONFIG_BSP_LEDPWM1=14
CONFIG_BSP_LEDPWM2=47
CONFIG_BSP_LEDPWM3=-1
CONFIG_BSP_MCPWM0=38
CONFIG_BSP_MCPWM1=45
CONFIG_BSP_MCPWM2=-1
CONFIG_BSP_MCPWM3=-1
CONFIG_BSP_PCINT=42
CONFIG_BSP_PDM0=-1
CONFIG_BSP_PDM1=-1
CONFIG_BSP_PDM2=-1
CONFIG_BSP_PDM3=-1
CONFIG_BSP_SPI2_DISPLAY_DC=9
CONFIG_BSP_SPI3_DISPLAY_CS=5
CONFIG_BSP_SPI3_DISPLAY_DC=4
CONFIG_BSP_SPI3_MISO=21
CONFIG_BSP_SPI3_MOSI=6
CONFIG_BSP_SPI3_SCK=7
CONFIG_BSP_SPIRAM_SIZE=16384
CONFIG_BSP_UART_RXD=44
CONFIG_BSP_UART_TXD=43
CONFIG_ESPTOOLPY_FLASHSIZE_16MB=y
CONFIG_LWIP_LOCAL_HOSTNAME="esp32-box3"
CONFIG_PARTITION_TABLE_CUSTOM_FILENAME="board/espressif-s3-box3/partitions.csv"
CONFIG_SPIRAM_MODE_OCT=y
CONFIG_SPIRAM_TYPE_AUTO=y
```

## board/lilygo-t7-s3/sdkconfig.defaults
```kconfig
CONFIG_BSP_BOARD_TYPE_NAME="LilyGO T7 S3"
CONFIG_BSP_FLASH_SIZE=16384
CONFIG_BSP_I2C0_SCL=16
CONFIG_BSP_I2C0_SDA=15
CONFIG_BSP_I2C1_SCL=7
CONFIG_BSP_I2C1_SDA=6
CONFIG_BSP_I2C2_SCL=0
CONFIG_BSP_I2C2_SDA=3
CONFIG_BSP_LEDPIXEL0=-1
CONFIG_BSP_LEDPIXEL1=9
CONFIG_BSP_LEDPIXEL2=14
CONFIG_BSP_LEDPIXEL3=-1
CONFIG_BSP_LEDPWM0=17
CONFIG_BSP_LEDPWM1=4
CONFIG_BSP_LEDPWM2=42
CONFIG_BSP_LEDPWM3=41
CONFIG_BSP_MCPWM0=5
CONFIG_BSP_MCPWM1=18
CONFIG_BSP_MCPWM2=39
CONFIG_BSP_MCPWM3=40
CONFIG_BSP_PCINT=8
CONFIG_BSP_PDM0=1
CONFIG_BSP_PDM1=-1
CONFIG_BSP_PDM2=-1
CONFIG_BSP_PDM3=-1
CONFIG_BSP_SPI2_DISPLAY_DC=38
CONFIG_BSP_SPI3_DISPLAY_CS=48
CONFIG_BSP_SPI3_DISPLAY_DC=21
CONFIG_BSP_SPI3_MISO=45
CONFIG_BSP_SPI3_MOSI=47
CONFIG_BSP_SPI3_SCK=46
CONFIG_BSP_SPIRAM_SIZE=8192
CONFIG_BSP_UART_RXD=44
CONFIG_BSP_UART_TXD=43
CONFIG_ESPTOOLPY_FLASHSIZE_16MB=y
CONFIG_LWIP_LOCAL_HOSTNAME="esp32-lilygo"
CONFIG_PARTITION_TABLE_CUSTOM_FILENAME="board/lilygo-t7-s3/partitions.csv"
CONFIG_SPIRAM_MODE_OCT=y
CONFIG_SPIRAM_TYPE_ESPPSRAM64=y
```

## board/wemos-lolin-s3-mini/sdkconfig.defaults
```kconfig
CONFIG_ESPTOOLPY_FLASHSIZE_4MB=y
CONFIG_SPIRAM_TYPE_ESPPSRAM16=y
CONFIG_SPIRAM_MODE_OCT=n
CONFIG_PARTITION_TABLE_CUSTOM_FILENAME="board/wemos-lolin-s3-mini/partitions.csv"
CONFIG_LWIP_LOCAL_HOSTNAME="esp32-wemos"
CONFIG_BSP_BOARD_TYPE_NAME="WEMOS Lolin S3 Mini"
CONFIG_BSP_FLASH_SIZE=4096
CONFIG_BSP_SPIRAM_SIZE=2048
CONFIG_BSP_SPI2_DISPLAY_DC=1
CONFIG_BSP_SPI3_DISPLAY_DC=21
CONFIG_BSP_SPI3_SCK=44
CONFIG_BSP_SPI3_MOSI=18
CONFIG_BSP_SPI3_MISO=43
CONFIG_BSP_SPI3_DISPLAY_CS=16
CONFIG_BSP_I2C0_SDA=5
CONFIG_BSP_I2C0_SCL=6
CONFIG_BSP_I2C1_SDA=14
CONFIG_BSP_I2C1_SCL=15
CONFIG_BSP_I2C2_SDA=3
CONFIG_BSP_I2C2_SCL=2
CONFIG_BSP_MCPWM0=8
CONFIG_BSP_MCPWM1=9
CONFIG_BSP_MCPWM2=-1
CONFIG_BSP_MCPWM3=-1
CONFIG_BSP_LEDPWM0=-1
CONFIG_BSP_LEDPWM1=4
CONFIG_BSP_LEDPWM2=17
CONFIG_BSP_LEDPWM3=34
CONFIG_BSP_PDM0=33
CONFIG_BSP_PDM1=-1
CONFIG_BSP_PDM2=-1
CONFIG_BSP_PDM3=-1
CONFIG_BSP_LEDPIXEL0=47
CONFIG_BSP_LEDPIXEL1=37
CONFIG_BSP_LEDPIXEL2=38
CONFIG_BSP_LEDPIXEL3=-1
CONFIG_BSP_UART_TXD=35
CONFIG_BSP_UART_RXD=36
CONFIG_BSP_PCINT=7
```

## main/Kconfig.projbuild
```kconfig
config BUILD_NETPERF_CODE
	prompt "Include network performance testing code in the build"
	help
		Include code that creates extra threads for network speed testing. If in doubt, select N.
	bool
	default n

menu "BSP - do not change, set automically, when invoked using script idf"

	config BSP_BOARD_TYPE_NAME
		string "Board type name"

	config BSP_FLASH_SIZE
		int "FLASH size"

	config BSP_SPIRAM_SIZE
		int "SPIRAM size"

	config BSP_SPI2_DISPLAY_DC
		int "GPIO used for D/C of display on SPI2"

	config BSP_SPI3_DISPLAY_DC
		int "GPIO used for D/C of display on SPI3"

	config BSP_SPI3_DISPLAY_CS
		int "GPIO used for SPI3 CS of display on SPI3"

	config BSP_SPI3_SCK
		int "GPIO used for SPI3 SCK"

	config BSP_SPI3_MOSI
		int "GPIO used for SPI3 MOSI"

	config BSP_SPI3_MISO
		int "GPIO used for SPI3 MISO"

	config BSP_I2C0_SDA
		int "GPIO used for SDA on first I2C module"

	config BSP_I2C0_SCL
		int "GPIO used for SCL on first I2C module"

	config BSP_I2C1_SDA
		int "GPIO used for SDA on second I2C module"

	config BSP_I2C1_SCL
		int "GPIO used for SCL on second I2C module"

	config BSP_MCPWM0
		int "GPIO used for MCPWM0 @ 150 Hz / 16 bit"

	config BSP_MCPWM1
		int "GPIO used for MCPWM1 @ 150 Hz / 16 bit"

	config BSP_MCPWM2
		int "GPIO used for MCPWM2 @ 2400 Hz / 16 bit"

	config BSP_MCPWM3
		int "GPIO used for MCPWM3 @ 2400 Hz / 16 bit"

	config BSP_LEDPWM0
		int "GPIO used for LEDPWM0 @ 5 kHz/14 bit (notify)"

	config BSP_LEDPWM1
		int "GPIO used for LEDPWM1 @ 5 kHz/14 bit (LCD SPI 2)"

	config BSP_LEDPWM2
		int "GPIO used for LEDPWM2 @ 5 kHz/14 bit (LCD SPI 3)"

	config BSP_LEDPWM3
		int "GPIO used for LEDPWM3 @ 120 Hz/14 bit"

	config BSP_PDM0
		int "GPIO used for PDM0 @ 150 kHz / 8 bit"

	config BSP_PDM1
		int "GPIO used for PDM1 @ 150 kHz / 8 bit"

	config BSP_PDM2
		int "GPIO used for PDM2 @ 150 kHz / 8 bit"

	config BSP_PDM3
		int "GPIO used for PDM3 @ 150 kHz / 8 bit"

	config BSP_LEDPIXEL0
		int "GPIO used for LEDpixel 0 (notify)"

	config BSP_LEDPIXEL1
		int "GPIO used for LEDpixel 1"

	config BSP_LEDPIXEL2
		int "GPIO used for LEDpixel 2"

	config BSP_LEDPIXEL3
		int "GPIO used for LEDpixel 3"
endmenu
```

## sdkconfig.defaults
```kconfig
CONFIG_BOOTLOADER_APP_ROLLBACK_ENABLE=y
CONFIG_BOOTLOADER_LOG_COLORS=y
CONFIG_BT_CTRL_BLE_MAX_ACT=2
CONFIG_BT_ENABLED=y
CONFIG_BT_NIMBLE_50_FEATURE_SUPPORT=n
CONFIG_BT_NIMBLE_ANS_SERVICE=n
CONFIG_BT_NIMBLE_ATT_PREFERRED_MTU=560
CONFIG_BT_NIMBLE_BAS_SERVICE=n
CONFIG_BT_NIMBLE_CTS_SERVICE=n
CONFIG_BT_NIMBLE_DIS_SERVICE=n
CONFIG_BT_NIMBLE_ENABLE_CONN_REATTEMPT=n
CONFIG_BT_NIMBLE_ENABLED=y
CONFIG_BT_NIMBLE_GATT_MAX_PROCS=1
CONFIG_BT_NIMBLE_HOST_ALLOW_CONNECT_WITH_SCAN=y
CONFIG_BT_NIMBLE_HR_SERVICE=n
CONFIG_BT_NIMBLE_HTP_SERVICE=n
CONFIG_BT_NIMBLE_IAS_SERVICE=n
CONFIG_BT_NIMBLE_IPSS_SERVICE=n
CONFIG_BT_NIMBLE_LLS_SERVICE=n
CONFIG_BT_NIMBLE_MAX_BONDS=0
CONFIG_BT_NIMBLE_MAX_CCCDS=0
CONFIG_BT_NIMBLE_MAX_CONNECTIONS=1
CONFIG_BT_NIMBLE_MEM_ALLOC_MODE_DEFAULT=y
CONFIG_BT_NIMBLE_MEMPOOL_RUNTIME_ALLOC=y
CONFIG_BT_NIMBLE_PRINT_ERR_NAME=n
CONFIG_BT_NIMBLE_PROX_SERVICE=n
CONFIG_BT_NIMBLE_ROLE_BROADCASTER=n
CONFIG_BT_NIMBLE_ROLE_CENTRAL=n
CONFIG_BT_NIMBLE_ROLE_OBSERVER=n
CONFIG_BT_NIMBLE_SECURITY_ENABLE=n
CONFIG_BT_NIMBLE_SPS_SERVICE=n
CONFIG_BT_NIMBLE_SVC_GAP_DEVICE_NAME="esp32s3"
CONFIG_BT_NIMBLE_TPS_SERVICE=n
CONFIG_COMPILER_CXX_EXCEPTIONS=y
CONFIG_COMPILER_CXX_RTTI=y
CONFIG_COMPILER_OPTIMIZATION_SIZE=y
CONFIG_COMPILER_STACK_CHECK_MODE_NORM=y
CONFIG_COMPILER_WARN_WRITE_STRINGS=y
CONFIG_ESP32S3_DATA_CACHE_64KB=y
CONFIG_ESP32S3_DATA_CACHE_LINE_64B=y
CONFIG_ESP32S3_INSTRUCTION_CACHE_32KB=y
CONFIG_ESP32S3_REV_MIN_1=y
CONFIG_ESP_CONSOLE_USB_SERIAL_JTAG=y
CONFIG_ESP_DEBUG_STUBS_ENABLE=y
CONFIG_ESP_DEFAULT_CPU_FREQ_MHZ_240=y
CONFIG_ESP_MAIN_TASK_AFFINITY_CPU1=y
CONFIG_ESP_MAIN_TASK_STACK_SIZE=4096
CONFIG_ESP_NETIF_IP_LOST_TIMER_INTERVAL=600
CONFIG_ESP_NETIF_RECEIVE_REPORT_ERRORS=y
CONFIG_ESP_SYSTEM_BBPLL_RECALIB=n
CONFIG_ESP_TASK_WDT_PANIC=y
CONFIG_ESPTOOLPY_FLASH_MODE_AUTO_DETECT=n
CONFIG_ESPTOOLPY_FLASHMODE_QIO=y
CONFIG_ESP_WIFI_CACHE_TX_BUFFER_NUM=16
CONFIG_ESP_WIFI_ENABLE_WPA3_OWE_STA=n
CONFIG_ESP_WIFI_ENABLE_WPA3_SAE=n
CONFIG_ESP_WIFI_ENTERPRISE_SUPPORT=n
CONFIG_ESP_WIFI_ESPNOW_MAX_ENCRYPT_NUM=0
CONFIG_ESP_WIFI_GMAC_SUPPORT=n
CONFIG_ESP_WIFI_IRAM_OPT=n
CONFIG_ESP_WIFI_RX_BA_WIN=2
CONFIG_ESP_WIFI_RX_IRAM_OPT=n
CONFIG_ESP_WIFI_TX_BA_WIN=2
CONFIG_FREERTOS_GENERATE_RUN_TIME_STATS=y
CONFIG_FREERTOS_RUN_TIME_COUNTER_TYPE_U64=y
CONFIG_FREERTOS_TIMER_SERVICE_TASK_NAME="timer-svc"
CONFIG_FREERTOS_USE_LIST_DATA_INTEGRITY_CHECK_BYTES=y
CONFIG_FREERTOS_VTASKLIST_INCLUDE_COREID=y
CONFIG_FREERTOS_WATCHPOINT_END_OF_STACK=y
CONFIG_HAL_WDT_USE_ROM_IMPL=n
CONFIG_HEAP_ABORT_WHEN_ALLOCATION_FAILS=y
CONFIG_HEAP_PLACE_FUNCTION_INTO_FLASH=y
CONFIG_HEAP_POISONING_LIGHT=y
CONFIG_IDF_EXPERIMENTAL_FEATURES=y
CONFIG_IDF_TARGET="esp32s3"
CONFIG_LITTLEFS_HUMAN_READABLE=y
CONFIG_LITTLEFS_MAX_PARTITIONS=1
CONFIG_LOG_COLORS=y
CONFIG_LOG_DEFAULT_LEVEL_WARN=y
CONFIG_LOG_TIMESTAMP_SOURCE_NONE=y
CONFIG_LOG_VERSION_2=y
CONFIG_LWIP_BRIDGEIF_MAX_PORTS=1
CONFIG_LWIP_BROADCAST_PING=y
CONFIG_LWIP_CHECKSUM_CHECK_IP=y
CONFIG_LWIP_CHECKSUM_CHECK_UDP=y
CONFIG_LWIP_DHCP_DOES_NOT_CHECK_OFFERED_IP=y
CONFIG_LWIP_DHCP_GET_NTP_SRV=y
CONFIG_LWIP_DHCP_MAX_NTP_SERVERS=2
CONFIG_LWIP_DHCPS_MAX_STATION_NUM=1
CONFIG_LWIP_DNS_MAX_SERVERS=2
CONFIG_LWIP_DNS_SUPPORT_MDNS_QUERIES=n
CONFIG_LWIP_HOOK_IP6_INPUT_NONE=y
CONFIG_LWIP_IP4_REASSEMBLY=y
CONFIG_LWIP_IP6_REASSEMBLY=y
CONFIG_LWIP_IP_DEFAULT_TTL=4
CONFIG_LWIP_IP_REASS_MAX_PBUFS=100
CONFIG_LWIP_IPV6_ND6_NUM_NEIGHBORS=3
CONFIG_LWIP_MAX_ACTIVE_TCP=1
CONFIG_LWIP_MAX_LISTENING_TCP=1
CONFIG_LWIP_MAX_RAW_PCBS=2
CONFIG_LWIP_MAX_UDP_PCBS=4
CONFIG_LWIP_MULTICAST_PING=y
CONFIG_LWIP_NETIF_LOOPBACK=n
CONFIG_LWIP_SO_LINGER=y
CONFIG_LWIP_SO_RCVBUF=y
CONFIG_LWIP_TCPIP_TASK_AFFINITY_CPU0=y
CONFIG_MBEDTLS_CCM_C=n
CONFIG_MBEDTLS_CERTIFICATE_BUNDLE=n
CONFIG_MBEDTLS_ECP_DP_BP256R1_ENABLED=n
CONFIG_MBEDTLS_ECP_DP_BP384R1_ENABLED=n
CONFIG_MBEDTLS_ECP_DP_BP512R1_ENABLED=n
CONFIG_MBEDTLS_ECP_DP_CURVE25519_ENABLED=n
CONFIG_MBEDTLS_ECP_DP_SECP192K1_ENABLED=n
CONFIG_MBEDTLS_ECP_DP_SECP192R1_ENABLED=n
CONFIG_MBEDTLS_ECP_DP_SECP224K1_ENABLED=n
CONFIG_MBEDTLS_ECP_DP_SECP224R1_ENABLED=n
CONFIG_MBEDTLS_ECP_DP_SECP256K1_ENABLED=n
CONFIG_MBEDTLS_ECP_DP_SECP384R1_ENABLED=n
CONFIG_MBEDTLS_ECP_DP_SECP521R1_ENABLED=n
CONFIG_MBEDTLS_ECP_NIST_OPTIM=n
CONFIG_MBEDTLS_ECP_RESTARTABLE=y
CONFIG_MBEDTLS_EXTERNAL_MEM_ALLOC=y
CONFIG_MBEDTLS_GCM_C=n
CONFIG_MBEDTLS_PEM_PARSE_C=n
CONFIG_MBEDTLS_PEM_WRITE_C=n
CONFIG_MBEDTLS_TLS_DISABLED=y
CONFIG_MBEDTLS_X509_CRL_PARSE_C=n
CONFIG_MBEDTLS_X509_CSR_PARSE_C=n
CONFIG_PARTITION_TABLE_CUSTOM=y
CONFIG_PM_POWER_DOWN_CPU_IN_LIGHT_SLEEP=n
CONFIG_PTHREAD_DEFAULT_CORE_1=y
CONFIG_SPI_FLASH_ENABLE_COUNTERS=y
CONFIG_SPI_FLASH_ENABLE_ENCRYPTED_READ_WRITE=n
CONFIG_SPI_FLASH_HPM_DIS=y
CONFIG_SPI_FLASH_LOG_FAILED_WRITE=y
CONFIG_SPI_FLASH_ROM_DRIVER_PATCH=n
CONFIG_SPI_FLASH_VERIFY_WRITE=y
CONFIG_SPI_FLASH_WARN_SETTING_ZERO_TO_ONE=y
CONFIG_SPIRAM_ALLOW_BSS_SEG_EXTERNAL_MEMORY=y
CONFIG_SPIRAM_ALLOW_NOINIT_SEG_EXTERNAL_MEMORY=y
CONFIG_SPIRAM_MALLOC_ALWAYSINTERNAL=512
CONFIG_SPIRAM_SPEED_80M=y
CONFIG_SPIRAM_TRY_ALLOCATE_WIFI_LWIP=y
CONFIG_SPIRAM=y
CONFIG_SPI_SLAVE_ISR_IN_IRAM=n
CONFIG_ULP_COPROC_ENABLED=y
CONFIG_ULP_COPROC_RESERVE_MEM=32
CONFIG_VFS_SEMIHOSTFS_MAX_MOUNT_POINTS=4
CONFIG_VFS_SUPPORT_TERMIOS=n
```
